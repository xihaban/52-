#include <REG52.H>    
#include <INTRINS.H>    
 
sbit Beep =  P1^5 ; 
unsigned char n = 0; 
   
unsigned char code music[] ={   
0x18, 0x30, 0x1C , 0x10,    
0x20, 0x40, 0x1C , 0x10,   
0x18, 0x10, 0x20 , 0x10,   
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0x18, 0x80, 0x00   
};   
 
  
void int0()  interrupt 1   
{
	TH0 = 0xd8;   
	TL0 = 0xf0;   
	n--;   
}
 
void delay (unsigned char m)   //频率延时    
{   
	unsigned i=3*m;   
	while(--i);   
} 
 
void BeepTone(unsigned char tone, unsigned char beat)   
{
	n = beat;
	TR0 = 1; 
   	while(n != 0) 
	{
		Beep = ~Beep;
		delay(tone);
	}
	TR0 = 0; 
}
   
 
void Delay10ms(unsigned int c)   //毫秒延迟
{
    unsigned char a, b;
 
    for (;c>0;c--)
	{
		for (b=38;b>0;b--)
		{
			for (a=130;a>0;a--);
		}
           
	}       
}
 
 
void InitTimer0()
{
	TMOD = 0x01; 
	TH0 = 0xd8;	
	TL0 = 0xf0; 
	IE=0x82;  
}
 
void PlaySong()
{
	unsigned char i=0;
	unsigned char tmpTone = 0;
 
	while(1)   
	{
		tmpTone = music[i]; 
		if(tmpTone == 0x00)  
		{
			return;
		}       
		else if(tmpTone == 0xff)  
		{ 
			++i;
			Delay10ms(10),
			TR0=0; 
			continue;
		}      
        else 
		{
			unsigned char tone, beat;
			tone = music[i++];
			beat = music[i++];
			BeepTone(tone, beat);	
		}
	}   
}
 
 
   
void main()   
{
	InitTimer0();
	while(1)   
	{
		PlaySong();
		Delay10ms(300);	
	}   
}  
